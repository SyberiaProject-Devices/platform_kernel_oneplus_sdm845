## drivers/oneplus/Kconfig
```kconfig
config OEM_SYSRQ_X
	default n
	depends on OEM_DEBUG_SUPPORT
	bool "echo x > /proc/sysrq-trigger to get init process stacktrace"

config OEM_DEBUG_SUPPORT
        bool
        default y

config OEM_TRACE_SUPPORT
	default n
	depends on OEM_DEBUG_SUPPORT
	bool "OEM debug function, enable it will register the device, which under /dev/otracer."


source "drivers/oneplus/coretech/Kconfig"
```

## drivers/oneplus/coretech/Kconfig
```kconfig
config OPCHAIN
	default n
	bool "Oneplus CoreTech helper, used for opchain module"

config DEFRAG_HELPER
	default n
	bool "Oneplus CoreTech helper, used for defrag module"

config CRPL_HELPER
	default n
	bool "Oneplus CoreTech helper, used for crpl module"

config HOUSTON
	default n
	bool "houston rocket play your temperature guard"
	help
	 Realtime temperature monitor
```
